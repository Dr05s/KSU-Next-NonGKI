## kernel/Kconfig
```kconfig
menu "KernelSU"

config KSU
	tristate "KernelSU function support"
	default y
	help
	  Enable kernel-level root privileges on Android System.
	  Requires CONFIG_KPROBES for kernel hooking support.
	  To compile as a module, choose M here: the
	  module will be called kernelsu.

config KSU_DEBUG
	bool "KernelSU debug mode"
	depends on KSU
	default n
	help
	  Enable KernelSU debug mode.

config KSU_DISABLE_MANAGER
	bool "Disable KernelSU manager integration"
	depends on KSU
	default n
	help
	  Disable manager APK detection and manager-specific handling.
	  Root will be used in place of manager-only functionality.

config KSU_DISABLE_POLICY
	bool "Disable KernelSU policy profiles"
	depends on KSU
	default n
	help
	  Disable per-app root/non-root profile customization.
	  Escalation will always use the default full root profile, and
	  non-root handling will follow the global umount policy only.

config KSU_ALLOWLIST_WORKAROUND
	bool "KernelSU allowlist workaround"
	depends on KSU
	default n
	help
	  Enable workaround for broken allowlist save

# For easier extern ifdef handling
config KSU_MANUAL_HOOK
	bool "KernelSU manual hook mode."
	depends on KSU && KSU != m
	default y if !KPROBES
	default n
	help
	  Enable manual hook support.

config KSU_SUSFS
	bool "KernelSU SUSFS support (manual hook)"
	depends on KSU && KSU_MANUAL_HOOK
	default n
	help
	  Enable the SUSFS command bridge for kernels that already contain
	  the SUSFS filesystem patches, headers and reboot manual hook.
	  Requires fs/susfs.c and include/linux/susfs*.h in the target kernel.
	  This option does not install SUSFS patches into the kernel.

config KSU_SUSFS_SUS_PATH
	bool "SUSFS: hide paths"
	depends on KSU_SUSFS
	default y

config KSU_SUSFS_SUS_MOUNT
	bool "SUSFS: hide mounts"
	depends on KSU_SUSFS
	default y

config KSU_SUSFS_SUS_KSTAT
	bool "SUSFS: spoof stat information"
	depends on KSU_SUSFS
	default y

config KSU_SUSFS_TRY_UMOUNT
	bool "SUSFS: try umount"
	depends on KSU_SUSFS
	default y

config KSU_SUSFS_SPOOF_UNAME
	bool "SUSFS: spoof uname"
	depends on KSU_SUSFS
	default y

config KSU_SUSFS_ENABLE_LOG
	bool "SUSFS: runtime log control"
	depends on KSU_SUSFS
	default y
	help
	  Enables CMD_SUSFS_ENABLE_LOG (0x555a0) for ksu_susfs.

config KSU_SUSFS_SPOOF_CMDLINE_OR_BOOTCONFIG
	bool "SUSFS: spoof cmdline or bootconfig"
	depends on KSU_SUSFS
	default y

config KSU_SUSFS_OPEN_REDIRECT
	bool "SUSFS: open redirect"
	depends on KSU_SUSFS
	default y

config KSU_SUSFS_SUS_MAP
	bool "SUSFS: hide memory maps"
	depends on KSU_SUSFS
	default y

choice
	prompt "KernelSU dynamic hook mode"
	depends on KSU && !KSU_MANUAL_HOOK
	default KSU_KPROBES_HOOK

config KSU_KPROBES_HOOK
	bool "KernelSU tracepoint+kretprobe hook"
	depends on KRETPROBES && KPROBES && HAVE_SYSCALL_TRACEPOINTS
	help
	  Enable KPROBES, KRETPROBES and TRACEPOINT hook for KernelSU core.
	  This should not be used on kernel below 5.10.

config KSU_SYSCALL_TABLE_HOOK
	bool "KernelSU syscall table patching hook"
	depends on ARM64 || X86_64
	help
	  Patch sys_call_table entries directly to hook syscalls without
	  kprobes or tracepoints. Intended for non-GKI kernels where kprobes
	  are unavailable or non-functional.
	  Requires kernel >= 4.17 (pt_regs-based syscall ABI).

endchoice

menu "KernelSU - SUSFS"
    depends on KSU_SUSFS

comment "------------------------WARNING-------------------------------"
comment "If anything mismatch with simonpunk's patch, Kernel compile maybe FAILED!"
comment "See simonpunk's original patch if you face any compile failed due to hook check"
comment "Repo: https://gitlab.com/simonpunk/susfs4ksu"
comment "--------------------------------------------------------------"
config KSU_SUSFS_SUS_PATH
    bool "Enable to hide suspicious path"
    depends on KSU_SUSFS
    default y
    help
        - Allow hiding the user-defined path and all its sub-paths from various system calls.
        - Use "add_sus_path_loop" instead of "add_sus_path" if the user-defined path is frequently modified.
        - Use with caution, as it may cause performance loss and be vulnerable to side-channel attacks.
          just disable this feature if it doesn't work for you or you don't need it at all.
        - Effective only on zygote spawned user app process with uid >= 10000.

config KSU_SUSFS_SUS_MOUNT
    bool "Enable to hide suspicious mounts"
    depends on KSU_SUSFS
    default y
    help
        - Automatically assign fake mnt_id and fake mnt_group_id for mounts mounted by ksu process until /sdcard is decrypted, this is to evade from mnt_id/mnt_group_id gap detections.
        - Allow hiding all sus mounts from /proc/self/[mounts|mountinfo|mountstat] for non-su processes.

config KSU_SUSFS_SUS_KSTAT
    bool "Enable to spoof suspicious kstat"
    depends on KSU_SUSFS
    default y
    help
        - Allow spoofing the kstat of user-defined file/directory.
        - Effective only on zygote spawned user app process with uid >= 10000.

config KSU_SUSFS_SPOOF_UNAME
    bool "Enable to spoof uname"
    depends on KSU_SUSFS
    default y
    help
        - Allow spoofing the string returned by uname syscall to user-defined string.
        - Effective on all processes.

config KSU_SUSFS_ENABLE_LOG
    bool "Enable logging susfs log to kernel"
    depends on KSU_SUSFS
    default y
    help
        - Allow logging susfs log to kernel, uncheck it to completely disable all susfs log.

config KSU_SUSFS_HIDE_KSU_SUSFS_SYMBOLS
    bool "Enable to automatically hide ksu and susfs symbols from /proc/kallsyms"
    depends on KSU_SUSFS
    default y
    help
        - Automatically hide ksu and susfs symbols from '/proc/kallsyms'.
        - Effective on all processes.

config KSU_SUSFS_SPOOF_CMDLINE_OR_BOOTCONFIG
    bool "Enable to spoof /proc/bootconfig (gki) or /proc/cmdline (non-gki)"
    depends on KSU_SUSFS
    default y
    help
        - Spoof the output of /proc/bootconfig (gki) or /proc/cmdline (non-gki) with a user-defined file.
        - Effective on all processes.

config KSU_SUSFS_OPEN_REDIRECT
    bool "Enable to redirect a path to be opened with another path (experimental)"
    depends on KSU_SUSFS
    default y
    help
        - Allow redirecting a target path to be opened with another user-defined path.
        - Please be reminded that process with open access to the target and redirected path can be detected.
        - Effective only on processes with uid < 2000.

config KSU_SUSFS_SUS_MAP
    bool "Enable hiding some mmapped real files from different proc maps interfaces"
    depends on KSU_SUSFS
    default y
    help
        - Allow hiding mmapped real files from /proc/<pid>/[maps|smaps|smaps_rollup|map_files|mem|pagemap]
        - It does NOT support hiding anon memory.
        - It does NOT hide any inline hooks or PLT hooks caused by the injected library itself.
        - It may not be able to evade detections by apps that implement a good injection detection.
        - Effective only on zygote spawned umounted user app process >= 10000.

endmenu

endmenu
```
